## testing/conf/local.conf
```bitbake
//hydra.log.LogPrms-file_logLevel = fine;

hydra.GemFirePrms-logLevel = fine;
hydra.VmPrms-extraVMArgs = "-DDistributionManager.VERBOSE=true";
hydra.VmPrms-extraVMArgs += "-DDistributionManager.DEBUG_JAVAGROUPS=true";
//hydra.VmPrms-extraVMArgs = "-Xms1024m -Xmx1024m -DDistributionManager.VERBOSE=true";
// -DDistributionManager.SERIAL_QUEUE_BYTE_LIMIT=10000000";
//hydra.VmPrms-extraVMArgs = "-Xms1024m -Xmx1024m";

// locator verbosity
hydra.GemFirePrms-extraLocatorVMArgs += "-DDistributionManager.DEBUG_JAVAGROUPS=true -DDistributionManager.VERBOSE=true -Xms100m -Xmx100m";

// locator lossiness
hydra.GemFirePrms-extraLocatorVMArgs += "-Dp2p.simulateDiscard=true";

// turn off udp direct-ack protocol
hydra.GemFirePrms-extraVMArgs += "-Dgemfire.disable-udp-direct-ack=true";

//hydra.GemFirePrms-enableMcast = false;
//hydra.GemFirePrms-useLocator = true;
//hydra.GemFirePrms-disableTcp = true;
//hydra.GemFirePrms-mcastFlowControlByteAllowance = 75000;
hydra.Prms-startLocatorAgentsBeforeTest = false;

//hydra.Prms-randomSeed=1152280458518;

//hydra.VmPrms-extraVMArgs +="-Dgemfire.enable-time-statistics=true";
//hydra.VmPrms-extraVMArgs += "-Dp2p.enableJgStackStats=true";
```
